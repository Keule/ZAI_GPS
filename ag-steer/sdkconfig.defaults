## ag-steer/sdkconfig.defaults
```kconfig
# sdkconfig.defaults for LilyGO T-ETH-Lite-S3
# ESP32-S3-WROOM-1-N8R8: 16 MB Flash, 8 MB Octal PSRAM

# === PSRAM ===
CONFIG_SPIRAM=y
CONFIG_SPIRAM_MODE_OCT=y
CONFIG_SPIRAM_SPEED_80M=y
CONFIG_SPIRAM_IGNORE_NOTFOUND=y

# === Flash & App Settings ===
CONFIG_ESPTOOLPY_FLASHMODE_QIO=y
CONFIG_ESPTOOLPY_FLASHFREQ_80M=y
CONFIG_ESPTOOLPY_FLASHSIZE_16MB=y

# === FreeRTOS ===
CONFIG_FREERTOS_HZ=1000

# === Logging ===
CONFIG_LOG_DEFAULT_LEVEL_INFO=y
CONFIG_LOG_MAXIMUM_LEVEL_DEBUG=y
```

## sdkconfig.defaults
```kconfig
# sdkconfig.defaults for LilyGO T-ETH-Lite-S3
# ESP32-S3-WROOM-1-N8R8: 16 MB Flash, 8 MB Octal PSRAM

# === PSRAM ===
CONFIG_SPIRAM=y
CONFIG_SPIRAM_MODE_OCT=y
CONFIG_SPIRAM_SPEED_80M=y
CONFIG_SPIRAM_IGNORE_NOTFOUND=y

# === Flash & App Settings ===
CONFIG_ESPTOOLPY_FLASHMODE_QIO=y
CONFIG_ESPTOOLPY_FLASHFREQ_80M=y
CONFIG_ESPTOOLPY_FLASHSIZE_16MB=y

# === FreeRTOS ===
CONFIG_FREERTOS_HZ=1000

# === Task Watchdog ===
# TASK-045: raise timeout to reduce false-positive resets on ESP32 Classic
# under RMII/comm load while keeping panic diagnostics enabled.
CONFIG_ESP_TASK_WDT_EN=y
CONFIG_ESP_TASK_WDT_TIMEOUT_S=15
CONFIG_ESP_TASK_WDT_PANIC=y

# === Logging ===
CONFIG_LOG_DEFAULT_LEVEL_INFO=y
CONFIG_LOG_MAXIMUM_LEVEL_DEBUG=y
```
